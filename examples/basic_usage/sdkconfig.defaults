## host_test/integration_internal/sdkconfig.defaults
```kconfig
CONFIG_IDF_TARGET="linux"
CONFIG_WIFI_MANAGER_CMD_QUEUE_SIZE=10
CONFIG_WIFI_SSID="test_ssid"
CONFIG_WIFI_PASSWORD="test_password"
```

## host_test/test_config_storage/Kconfig.projbuild
```kconfig
menu "WIFI SSID Configuration"

    config WIFI_SSID
        string "WiFi SSID"
        default ""
        help
            SSID of the WiFi network to connect. Leave blank to use stored credentials on the target device.

    config WIFI_PASSWORD
        string "WiFi Password"
        default ""
        help
            Password of the WiFi network.

endmenu
```

## legacy_host_test/wifi_config_storage/sdkconfig.defaults
```kconfig
CONFIG_IDF_TARGET="linux"
CONFIG_WIFI_SSID="test_ssid"
CONFIG_WIFI_PASSWORD="test_password"
CONFIG_LOG_DEFAULT_LEVEL_NONE=y
CONFIG_LOG_DEFAULT_LEVEL=0
```

## wifi_manager/legacy_host_test/wifi_sync_manager/sdkconfig.defaults
```kconfig
CONFIG_IDF_TARGET="linux"
CONFIG_LOG_DEFAULT_LEVEL_NONE=y
CONFIG_LOG_DEFAULT_LEVEL=0
```
